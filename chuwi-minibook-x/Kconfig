## chuwi-minibook-x/Kconfig
```kconfig
#
# Chuwi Minibook X Platform Support
#

config CHUWI_MINIBOOK_X
	tristate "Chuwi Minibook X tablet mode and orientation support"
	depends on X86 && ACPI && INPUT && IIO && MXC4005 && SERIAL_MULTI_INSTANTIATE
	select INPUT_POLLDEV
	help
	  This driver provides tablet mode detection and screen orientation
	  support for the Chuwi Minibook X convertible laptop.
	  
	  The driver uses dual accelerometers (base and lid) to detect when
	  the device is folded into tablet mode and to provide automatic
	  screen rotation based on device orientation.
	  
	  Features include:
	  - Automatic tablet mode detection with configurable thresholds
	  - 4-way screen orientation detection (normal/left/inverted/right)
	  - Linux input subsystem integration for desktop environments
	  - Comprehensive sysfs interface for configuration and monitoring
	  - Auto-calibration of hinge axis from accelerometer data
	  
	  Say Y or M here if you have a Chuwi Minibook X and want tablet
	  mode and orientation detection support.

config CHUWI_MINIBOOK_X_DEBUGFS
	bool "Chuwi Minibook X debugging support"
	depends on CHUWI_MINIBOOK_X && DEBUG_FS
	help
	  Enable debugfs interface for detailed inspection of accelerometer
	  data, angle calculations, and internal module state. This is useful
	  for development and troubleshooting tablet mode detection issues.
	  
	  The debugfs interface provides:
	  - Raw accelerometer vector data and magnitudes
	  - Detailed angle calculation breakdowns
	  - Orientation detection statistics and confidence levels
	  - Hinge axis calibration information
	  
	  Say Y here if you need detailed debugging information for the
	  Chuwi Minibook X driver.
```

## cmx/Kconfig
```kconfig
#
# CMX - Chuwi Minibook X Platform Support
#

config CMX
	tristate "CMX - Chuwi Minibook X integrated platform driver"
	depends on X86 && ACPI && INPUT && IIO && I2C && MXC4005
	help
	  This driver provides integrated hardware support for the Chuwi Minibook X
	  convertible laptop, including:
	  
	  - Automatic I2C accelerometer device instantiation with proper mount matrices
	  - Tablet mode detection using dual accelerometers (base and lid)
	  - Screen orientation detection and reporting
	  - Linux input subsystem integration for desktop environments
	  - Comprehensive sysfs interface for configuration and monitoring
	  
	  The driver automatically detects and instantiates MXC4005 accelerometer
	  devices on the appropriate I2C buses with correct mount matrix transformations
	  for proper orientation handling. It provides tablet mode switching events
	  compatible with desktop environments like GNOME and KDE.
	  
	  Features include:
	  - Hardware-based DMI detection for supported devices
	  - Event-driven tablet mode detection with configurable thresholds
	  - Mount matrix support for correct accelerometer orientation
	  - Sysfs interface for runtime configuration and data input
	  - Module parameters for hardware configuration

	  The driver will need the supporting userspace daemon from:
	    https://github.com/greymouser/minibook-x-tools
	  
	  Say Y or M here if you have a Chuwi Minibook X and want integrated
	  hardware support with tablet mode detection.
```

## module-v1/module/Kconfig
```kconfig
# Configuration options for Chuwi Minibook X Tablet Mode module
#
# Copyright (c) 2025 Armando DiCianno <armando@noonshy.com>
# Licensed under GPL-2.0

config CHUWI_MINIBOOK_X_TABLET_MODE
	tristate "Chuwi Minibook X tablet mode detection"
	depends on INPUT && SYSFS
	help
	  This driver provides tablet mode detection for the Chuwi Minibook X
	  laptop by calculating hinge angles from accelerometer data.

	  The driver creates an input device that reports SW_TABLET_MODE events
	  based on configurable angle thresholds with hysteresis.

	  Configuration is available through sysfs in /sys/class/tablet_mode/.

	  If unsure, say N.

config CHUWI_MINIBOOK_X_TABLET_MODE_DEBUGFS
	bool "Enable debugfs support for Chuwi Minibook X tablet mode"
	depends on CHUWI_MINIBOOK_X_TABLET_MODE && DEBUG_FS
	help
	  Enable debugfs interface for advanced debugging of the tablet mode
	  detection algorithm.

	  This creates files under /sys/kernel/debug/chuwi-minibook-x-tablet-mode/:
	  - raw_data: Shows current accelerometer vectors and timestamps
	  - calculations: Shows detailed angle calculations and algorithm state

	  This option is primarily useful for development and troubleshooting.
	  
	  If unsure, say N.
```
